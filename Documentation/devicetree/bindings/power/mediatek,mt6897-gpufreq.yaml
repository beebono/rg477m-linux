## Documentation/devicetree/bindings/power/mediatek,mt6897-gpufreq.yaml
```yaml
# SPDX-License-Identifier: GPL-2.0-only OR BSD-2-Clause
%YAML 1.2
---
$id: http://devicetree.org/schemas/power/mediatek,mt6897-gpufreq.yaml#
$schema: http://devicetree.org/meta-schemas/core.yaml#

title: MediaTek MT6897 MFlexGraphics power controller (GPUEB)

maintainers:
  - FIXME Name <fixme@example.org>  # fill in before sending upstream

description:
  On MT6897 the GPUEB embedded MCU is started by the bootloader and does all
  GPU power and frequency sequencing. The AP sends it gpufreq IPIs over the
  GPUEB mailbox. The node is a power domain for the Mali GPU and provides a
  read-only clock reporting the frequency chosen by the GPUEB.

properties:
  $nodename:
    pattern: '^power-controller@[a-f0-9]+$'

  compatible:
    const: mediatek,mt6897-gpufreq

  reg:
    minItems: 4
    items:
      - description: GPUEB general purpose registers (GPR0..GPR24)
      - description: MFG_RPC registers, read for power status only
      - description: SPM XPU_PWR_STATUS and XPU_PWR_STATUS_2ND
      - description: GPUEB mailbox PDCA status register
      - description: first page of the GPU registers, read for identification

  reg-names:
    minItems: 4
    items:
      - const: gpr
      - const: rpc
      - const: spm-status
      - const: pdca-sta
      - const: gpu

  mboxes:
    maxItems: 11

  mbox-names:
    items:
      - const: fast-dvfs-event
      - const: gpufreq
      - const: sleep
      - const: timer
      - const: fhctl
      - const: ccf
      - const: gpumpu
      - const: fast-dvfs
      - const: ipir-c-met
      - const: ipis-c-met
      - const: brisket

  memory-region:
    items:
      - description: the gpufreq part of the GPUEB shared memory

  "#clock-cells":
    const: 0

  "#power-domain-cells":
    const: 0

required:
  - compatible
  - reg
  - reg-names
  - mboxes
  - mbox-names
  - memory-region
  - "#clock-cells"
  - "#power-domain-cells"

additionalProperties: false
```

## drivers/pmdomain/mediatek/Kconfig
```kconfig
# SPDX-License-Identifier: GPL-2.0-only

menu "MediaTek PM Domains"
	depends on ARCH_MEDIATEK || COMPILE_TEST

config MTK_SCPSYS
	bool "MediaTek SCPSYS Support"
	default ARCH_MEDIATEK
	depends on OF
	select REGMAP
	select MTK_INFRACFG
	select PM_GENERIC_DOMAINS if PM
	help
	  Say yes here to add support for the MediaTek SCPSYS power domain
	  driver.

config MTK_SCPSYS_PM_DOMAINS
	bool "MediaTek SCPSYS generic power domain"
	default ARCH_MEDIATEK
	depends on PM
	select PM_GENERIC_DOMAINS
	select REGMAP
	help
	  Say y here to enable power domain support.
	  In order to meet high performance and low power requirements, the System
	  Control Processor System (SCPSYS) has several power management related
	  tasks in the system.

config MTK_MFG_PM_DOMAIN
	bool "MediaTek MFlexGraphics power domain"
	default ARCH_MEDIATEK
	depends on PM
	depends on OF
	depends on COMMON_CLK
	select MAILBOX
	select PM_GENERIC_DOMAINS
	imply MTK_GPUEB_MBOX
	help
	  Say y or m here to enable the power domains driver for MediaTek
	  MFlexGraphics. This driver allows for power and frequency control of
	  GPUs on MediaTek SoCs such as the MT8196 or MT6991.

	  This driver is required for the Mali GPU to work at all on MT8196 and
	  MT6991.

config MTK_MFG_MT6897_PM_DOMAIN
	bool "MediaTek MT6897 MFlexGraphics power domain (GPUEB)"
	depends on ARCH_MEDIATEK || COMPILE_TEST
	depends on PM
	depends on OF
	depends on COMMON_CLK
	select MAILBOX
	select PM_GENERIC_DOMAINS
	imply MTK_GPUEB_MBOX
	help
	  Power domain and read-only GPU clock for the Mali GPU of the MediaTek
	  MT6897 (Dimensity 8300). The GPUEB co-processor, started by the
	  bootloader, does all GPU power sequencing; this driver only sends it
	  IPI commands. It never controls regulators or PLLs itself.

	  Bring-up triggers are exposed in debugfs under mt6897_gpu/.

config AIROHA_CPU_PM_DOMAIN
	tristate "Airoha CPU power domain"
	default ARCH_AIROHA
	depends on HAVE_ARM_SMCCC
	depends on PM
	select PM_GENERIC_DOMAINS
	help
	  Say y here to enable CPU power domain support for Airoha SoC.

	  CPU frequency and power is controlled by ATF with SMC command to
	  set performance states.

endmenu
```
